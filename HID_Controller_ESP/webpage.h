#pragma once

const char webpage[] PROGMEM = R"rawliteral(
<!DOCTYPE html>
<html lang="id">
<head>
<meta charset="UTF-8">
<meta name="viewport" content="width=device-width, initial-scale=1.0">
<link href="https://fonts.googleapis.com/css2?family=Roboto:wght@400;500;700&display=swap" rel="stylesheet">

<style>
*{
    margin:0;
    padding:0;
    box-sizing:border-box;
    font-family:'Roboto',sans-serif;
}
body{
    background:#000;
    color:#fff;
    padding:30px;
}
.header-container{
    display:flex;
    align-items:center;
    justify-content:center;
    gap:20px;
    margin-bottom:35px;
}
#logoCanvas{
    width:100px;
    height:100px;
    image-rendering:pixelated;
}
.page-title{
    font-size:24px;
    font-weight:700;
    text-align:center;
}
label{
    display:block;
    margin-bottom:8px;
    font-size:15px;
    font-weight:500;
}
select{
    width:100%;
    height:46px;
    background:#333;
    color:#fff;
    border:none;
    outline:none;
    padding:0 14px;
    font-size:16px;
    border-radius:0;
    cursor:pointer;
}
option{
    background:#fff;
    color:#000;
}
option:hover,
option:checked{
    background:#666;
    color:#fff;
}
.select-group{
    margin-bottom:24px;
}
.control-row{
    display:flex;
    justify-content:center;
    align-items:center;
    gap:45px;
    margin-top:40px;
    text-align:center;
    flex-wrap:wrap;
}
.control-item{
    min-width:120px;
}
.checkbox-control{
    display:flex;
    flex-direction:column;
    align-items:center;
    justify-content:center;
}
.checkbox-control .title{
    margin-bottom:10px;
    text-align:center;
    line-height:1.2;
}
input[type=checkbox]{
    appearance:none;
    width:32px;
    height:32px;
    background:#666;
    border:none;
    border-radius:0;
    cursor:pointer;
    position:relative;
}
input[type=checkbox]:checked{
    background:#fff;
}
input[type=checkbox]:checked::after{
    content:"✓";
    position:absolute;
    left:50%;
    top:50%;
    transform:translate(-50%,-58%);
    color:#000;
    font-size:24px;
    font-weight:bold;
}
.title{
    font-size:16px;
    color:#ccc;
    margin-bottom:6px;
}
.value,
.temperature{
    font-size:40px;
    font-weight:700;
    white-space:nowrap;
}
#time{
    font-size:40px;
    font-weight:700;
    letter-spacing:2px;
    white-space:nowrap;
}
#ignitorFaultPopup{
    display:none;
    position:fixed;
    inset:0;
    background:rgba(0,0,0,.75);
    z-index:9999;
    align-items:center;
    justify-content:center;
    padding:20px;
}
#ignitorFaultPopup.show{display:flex;}
#ignitorFaultBox{
    width:min(500px,100%);
    background:#222;
    border:2px solid #fff;
    padding:30px 24px;
    text-align:center;
    box-shadow:0 0 30px rgba(255,255,255,.25);
}
#ignitorFaultBox h2{font-size:24px;margin-bottom:14px;}
#ignitorFaultBox p{font-size:18px;line-height:1.5;}
@media(max-width:900px){
    body{padding:20px}
    .control-row{gap:25px}
    .control-item{min-width:100px}
    .value,#time,.temperature{font-size:32px}
    .title{font-size:14px}
    input[type=checkbox]{width:28px;height:28px}
    .header-container{
        flex-direction:column;
        gap:15px;
    }
}
@media(max-width:650px){
    .control-row{gap:15px}
    .control-item{min-width:80px}
    .value,#time,.temperature{font-size:25px}
    .title{font-size:12px}
}
</style>
</head>

<body>

<div class="header-container">
    <canvas id="logoCanvas"></canvas>
    <div class="page-title">Multi Vapour HID Street Light Controller</div>
</div>

<div class="select-group">
    <label for="mode">Mode</label>
    <select id="mode">
        <option value="1">OFF</option>
        <option value="2">18W</option>
        <option value="3">36W</option>
        <option value="4">54W</option>
        <option value="5">72W</option>
        <option value="6">90W</option>
        <option value="7">108W</option>
        <option value="8">126W</option>
        <option value="9">162W</option>
        <option value="10">Photoresistor</option>
        <option value="11">Auto</option>
    </select>
</div>

<div class="select-group">
    <label for="sensorCeiling">Sensor Ceiling</label>
    <select id="sensorCeiling">
        <option value="4">72W</option>
        <option value="5">90W</option>
        <option value="6">108W</option>
        <option value="7">126W</option>
        <option value="8">162W</option>
    </select>
</div>

<div id="ignitorFaultPopup">
    <div id="ignitorFaultBox">
        <h2>Lampu Bermasalah</h2>
        <p>mohon diperiksa</p>
    </div>
</div>

<div class="control-row">

    <div class="control-item checkbox-control">
        <div class="title">Startup<br>Photoresistor</div>
        <input type="checkbox" id="startupPhotoresistor">
    </div>

    <div class="control-item checkbox-control">
        <div class="title">Ignitor</div>
        <input type="checkbox" id="ignitor">
    </div>

    <div class="control-item">
        <div class="title">Status</div>
        <div class="value" id="status">OFF</div>
    </div>

    <div class="control-item">
        <div class="title">Ballast</div>
        <div class="temperature" id="ballastTemp">0.0°C</div>
    </div>

    <div class="control-item">
        <div class="title">Lamp Compartment</div>
        <div class="temperature" id="lampTemp">0.0°C</div>
    </div>

    <div class="control-item">
        <div class="title">Time</div>
        <div id="time">00:00:00</div>
    </div>

</div>

<script>
const mode = document.getElementById("mode");
const sensorCeiling = document.getElementById("sensorCeiling");
const startupPhotoresistor = document.getElementById("startupPhotoresistor");
const ignitor = document.getElementById("ignitor");
const statusEl = document.getElementById("status");
const ballastTempEl = document.getElementById("ballastTemp");
const lampTempEl = document.getElementById("lampTemp");
const timeEl = document.getElementById("time");
const ignitorFaultPopup = document.getElementById("ignitorFaultPopup");

const modeNames = {
    1:"OFF",
    2:"18W",
    3:"36W",
    4:"54W",
    5:"72W",
    6:"90W",
    7:"108W",
    8:"126W",
    9:"162W",
    10:"Photoresistor",
    11:"Auto"
};

function send(path){
    fetch(path, {cache:"no-store"})
        .catch(err => console.error("ESP32 request:", err));
}

mode.addEventListener("change", () => {
    send("/mode?value=" + encodeURIComponent(mode.value));
});

sensorCeiling.addEventListener("change", () => {
    send("/limit?value=" + encodeURIComponent(sensorCeiling.value));
});

startupPhotoresistor.addEventListener("change", () => {
    send("/photo?state=" + (startupPhotoresistor.checked ? "0" : "1"));
});

ignitor.addEventListener("change", () => {
    send("/ignitor?state=" + (ignitor.checked ? "1" : "0"));
});

function applyStatus(data){
    if(data.status !== undefined){
        const s = Number(data.status);
        statusEl.textContent = modeNames[s] || ("Status " + s);

        if(mode.value !== String(s)){
            mode.value = String(s);
        }
    }

    if(data.limit !== undefined){
        const l = Number(data.limit);
        if(l >= 4 && l <= 8){
            sensorCeiling.value = String(l);
        }
    }

    if(data.photostate !== undefined){
        startupPhotoresistor.checked = Number(data.photostate) === 0;
    }

    if(data.ignState !== undefined){
        ignitor.checked = Number(data.ignState) === 1;
    }

    if(data.ignFault !== undefined){
        ignitorFaultPopup.classList.toggle("show", Number(data.ignFault) === 1);
    }

    if(data.ballastTemp !== undefined){
        ballastTempEl.textContent = Number(data.ballastTemp).toFixed(1) + "°C";
    }

    if(data.lampTemp !== undefined){
        lampTempEl.textContent = Number(data.lampTemp).toFixed(1) + "°C";
    }

    if(data.time !== undefined){
        timeEl.textContent = data.time;
    }
}

async function updateFromESP(){
    try{
        const response = await fetch("/api/status", {
            cache:"no-store"
        });

        if(!response.ok) return;

        const data = await response.json();
        applyStatus(data);
    }catch(error){
        console.error("Telemetry error:", error);
    }
}

updateFromESP();
setInterval(updateFromESP, 1000);

// Bitmap logo
const logoData = [
    0xff, 0xff, 0xff, 0xff, 0xff, 0xff, 0xff, 0xff, 0xff, 0xff, 0xff, 0xff, 0xf0, 0xff, 0xff, 0xff, 
    0xff, 0xff, 0xff, 0xff, 0xff, 0xff, 0xff, 0xff, 0xff, 0xf0, 0xff, 0xff, 0xff, 0xff, 0xff, 0xff, 
    0xff, 0xff, 0xff, 0xff, 0xff, 0xff, 0xf0, 0xff, 0xff, 0xff, 0xff, 0xff, 0xff, 0xff, 0xff, 0xff, 
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    0xff, 0xff, 0xff, 0xf0
];

function drawBitmap(canvasId, hexArray){
    const canvas = document.getElementById(canvasId);
    const ctx = canvas.getContext("2d");
    const width = 100;
    const height = 100;
    const bytesPerRow = Math.ceil(width / 8);
    canvas.width = width;
    canvas.height = height;

    const imgData = ctx.createImageData(width, height);

    for(let y = 0; y < height; y++){
        for(let x = 0; x < width; x++){
            const byteIndex = y * bytesPerRow + Math.floor(x / 8);
            if(byteIndex >= hexArray.length) continue;

            const byte = hexArray[byteIndex];
            const bitIndex = 7 - (x % 8);
            const isPixelOn = (byte & (1 << bitIndex)) === 0;
            const index = (y * width + x) * 4;

            if(isPixelOn){
                imgData.data[index] = 255;
                imgData.data[index + 1] = 255;
                imgData.data[index + 2] = 255;
                imgData.data[index + 3] = 255;
            } else {
                imgData.data[index] = 0;
                imgData.data[index + 1] = 0;
                imgData.data[index + 2] = 0;
                imgData.data[index + 3] = 0;
            }
        }
    }
    ctx.putImageData(imgData, 0, 0);
}

drawBitmap("logoCanvas", logoData);
</script>

</body>
</html>
)rawliteral";
